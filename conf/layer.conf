## conf/layer.conf
```bitbake
# We have a conf and classes directory, add to BBPATH
BBPATH .= ":${LAYERDIR}"

# We have recipes-* directories, add to BBFILES
BBFILES += "${LAYERDIR}/recipes-*/*/*.bb \
            ${LAYERDIR}/recipes-*/*/*.bbappend"

BBFILE_COLLECTIONS += "meta-go-bin"
BBFILE_PATTERN_meta-go-bin = "^${LAYERDIR}/"
BBFILE_PRIORITY_meta-go-bin = "6"

LAYERDEPENDS_meta-go-bin = "core"
LAYERSERIES_COMPAT_meta-go-bin = "dunfell"
```
